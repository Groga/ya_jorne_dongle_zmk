## config/boards/shields/jorne_left/Kconfig.defconfig
```kconfig
if SHIELD_JORNE_LEFT

config ZMK_KEYBOARD_NAME
    default "Jorne"

config ZMK_SPLIT
    default y

config ZMK_SPLIT_ROLE_CENTRAL
    default n

endif # SHIELD_JORNE_LEFT
```

## config/boards/shields/jorne_right/Kconfig.defconfig
```kconfig
if SHIELD_JORNE_RIGHT

config ZMK_KEYBOARD_NAME
    default "Jorne"

config ZMK_SPLIT
    default y

endif # SHIELD_JORNE_RIGHT
```

/*
 * ------------------------------------------------------------------
 * Файл:      jorne_dongle.overlay
 * Версия:    2.0
 * Автор:     Evgeniy Moskovkin
 * Описание:  Донгл (центральная часть сплита). Своих клавиш нет —
 *            используется "заглушка" mock-kscan. physical-layout
 *            подключается ИЗ ТОГО ЖЕ общего файла jorne_common.dtsi,
 *            что и у обеих половинок.
 * ------------------------------------------------------------------
 */

#include "../jorne_common/jorne_common.dtsi"

/ {
    chosen {
        zmk,kscan = &mock_kscan;
        zmk,physical-layout = &physical_layout0;
    };

    mock_kscan: mock_kscan_0 {
        compatible = "zmk,kscan-mock";
        columns = <14>;
        rows = <4>;
        events = <0>;
    };
};

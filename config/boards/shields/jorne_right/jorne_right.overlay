/*
 * ------------------------------------------------------------------
 * Файл:      jorne_right.overlay
 * Версия:    3.0
 * Автор:     Evgeniy Moskovkin
 * Описание:  Правая половина Jorne (44 клавиши / split 3x6_3 + боковые).
 *            col-offset = 7, т.к. левая половина занимает столбцы 0..6.
 *            Столбцы (col-gpios) развёрнуты — подтверждено тестом
 *            (сдвиг u->i, i->o пропал после разворота порядка).
 *            Строки (row-gpios): row0/row2/row3 подтверждены тестом
 *            через отладочный лог. row1 (домашний ряд, pin7) — ПОКА
 *            НЕ ПОДТВЕРЖДЁН тестом (сам домашний ряд не откликнулся
 *            ни на один из уже проверенных пинов, pin7 — единственный
 *            оставшийся кандидат по исключению). После прошивки
 *            обязательно перепроверить hjkl;' через лог ещё раз.
 * ------------------------------------------------------------------
 */

#include "../jorne_common/jorne_common.dtsi"

/ {
    chosen {
        zmk,kscan = &kscan0;
        zmk,physical-layout = &physical_layout0;
    };

    kscan0: kscan {
        compatible = "zmk,kscan-gpio-matrix";
        wakeup-source;
        diode-direction = "col2row";

        col-gpios
            = <&pro_micro 14 GPIO_ACTIVE_HIGH>   // col 0 (внутренняя)
            , <&pro_micro 15 GPIO_ACTIVE_HIGH>   // col 1
            , <&pro_micro 18 GPIO_ACTIVE_HIGH>   // col 2
            , <&pro_micro 19 GPIO_ACTIVE_HIGH>   // col 3
            , <&pro_micro 20 GPIO_ACTIVE_HIGH>   // col 4
            , <&pro_micro 16 GPIO_ACTIVE_HIGH>   // col 5
            , <&pro_micro 21 GPIO_ACTIVE_HIGH>   // col 6 (боковая внешняя)
            ;

        row-gpios
            = <&pro_micro 4 (GPIO_ACTIVE_HIGH | GPIO_PULL_DOWN)>   // row 0 — верхний ряд      (подтверждено логом: Y U I O P [ ])
            , <&pro_micro 5 (GPIO_ACTIVE_HIGH | GPIO_PULL_DOWN)>   // row 1 — домашний ряд     (подтверждено логом: H J K L ; ')
            , <&pro_micro 6 (GPIO_ACTIVE_HIGH | GPIO_PULL_DOWN)>   // row 2 — нижний ряд       (подтверждено логом: N M , . / \)
            // 2026-09-03 (Evgeniy Moskovkin): было `pro_micro 8` (D8/P1.04) —
            // ряд больших пальцев не давал НИКАКИХ событий в логе. Левая
            // половина использует D7 (P0.11) и там пальцы работают; половины
            // разделяют один набор пинов, значит справа тоже D7, а D8 был
            // ошибкой. Исправлено:
            , <&pro_micro 7 (GPIO_ACTIVE_HIGH | GPIO_PULL_DOWN)>   // row 3 — большие пальцы   (было D8, молчал; D7 как на левой)
            ;
    };
};

&default_transform {
    col-offset = <7>;
};

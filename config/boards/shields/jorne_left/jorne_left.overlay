/*
 * ------------------------------------------------------------------
 * Файл:      jorne_left.overlay
 * Версия:    5.1
 * Автор:     Evgeniy Moskovkin
 * Описание:  Левая половина Jorne (44 клавиши / split 3x6_3 + боковые).
 *            Полностью переведена на метки &pro_micro — так же, как
 *            правая половина (jorne_right.overlay). Сырые пины
 *            &gpio0/&gpio1 больше не используются: их нельзя было
 *            сверить глазами с шёлкографией платы, и именно там и
 *            прятались ошибки.
 *
 * Источник карты пинов (авторитетный, не картинка):
 *            zmk/app/module/boards/nicekeyboards/nice_nano/
 *            arduino_pro_micro_pins.dtsi
 *            D4=P0.22, D5=P0.24, D6=P1.00, D7=P0.11,
 *            D10=P0.09, D14=P1.11, D15=P1.13, D16=P0.10,
 *            D18=P1.15, D19=P0.02, D20=P0.29, D21=P0.31
 *
 * История правок 2026-09-03 (Evgeniy Moskovkin):
 *   1. row-gpios переведены на &pro_micro 4/5/6/7. ПОДТВЕРЖДЕНО
 *      реальным USB-логом kscan_matrix_init_input_inst: прошивка
 *      настраивает ровно P0.22 / P0.24 / P1.00 / P0.11.
 *   2. col 0..3 переведены на &pro_micro 21/20/19/18. ПОДТВЕРЖДЕНО
 *      живым тестом на плате: клавиши ` q w e печатаются верно,
 *      то есть никакого "развёрнутого порядка" колонок здесь нет —
 *      прежний комментарий про разворот был ошибочным.
 *   3. Найдена причина мёртвых клавиш R/F/V: в прежней версии
 *      COL 4 = P0.28, а этого пина НЕТ на разъёме nice!nano вообще
 *      (в arduino_pro_micro_pins.dtsi он отсутствует). Прошивка
 *      настраивала выход, который никуда не подключён.
 *   4. COL 5 раньше был P0.09 (= D10, пин NFC-антенны). Даже с
 *      CONFIG_NFCT_PINS_AS_GPIOS=y клавиши T/G/B не ожили —
 *      значит это тоже не тот пин.
 *
 * v5.1 — правка по реальному логу kscan_matrix_read (верхний ряд):
 *   Гипотеза v5.0 (col4/5/6 = D16/D15/D14) оказалась сдвинута на одну
 *   позицию. Лог показал: физическая R даёт событие (0,5), а физическая
 *   T — (0,6), то есть R сидит на D15, а T на D14. Сдвинуто:
 *   col4 = D15, col5 = D14, D16 перенесён в col6.
 *
 * ОТКРЫТЫЙ ВОПРОС — внешняя колонка (GUI / CTRL / LALT):
 *   Лог показал, что угловая GUI даёт событие (3,0) → позиция 38,
 *   то есть попадает на тот же узел матрицы, что и левая клавиша Tab
 *   под большим пальцем. Это объясняет давнюю странность "GUI ведёт
 *   себя как Tab". Два варианта:
 *     а) внешняя колонка физически разведена на свободные места
 *        ряда 3 (частый приём: в ряду больших пальцев занято лишь
 *        3 позиции из 7) — тогда нужно менять matrix_transform,
 *        а не пины;
 *     б) при съёме лога случайно нажалась соседняя клавиша.
 *   Нужен отдельный точечный тест: нажать по одной GUI, CTRL, LALT
 *   и три клавиши большого пальца, сверить координаты в логе.
 *   D16 в col6 пока оставлен как рабочая гипотеза.
 * ------------------------------------------------------------------
 */

#include "../jorne_common/jorne_common.dtsi"

/ {
    chosen {
        zmk,kscan = &kscan0;
        zmk,physical-layout = &physical_layout0;
    };

    kscan0: kscan {
        compatible = "zmk,kscan-gpio-matrix";
        wakeup-source;
        diode-direction = "col2row";

        col-gpios
            = <&pro_micro 21 GPIO_ACTIVE_HIGH>  // COL 0 — ` / A / Z            (подтверждено логом: (0,0) поз.1)
            , <&pro_micro 20 GPIO_ACTIVE_HIGH>  // COL 1 — Q / S / X            (подтверждено логом: (0,1) поз.2)
            , <&pro_micro 19 GPIO_ACTIVE_HIGH>  // COL 2 — W / D / C            (подтверждено логом: (0,2) поз.3)
            , <&pro_micro 18 GPIO_ACTIVE_HIGH>  // COL 3 — E / F / V            (подтверждено логом: (0,3) поз.4)
            , <&pro_micro 15 GPIO_ACTIVE_HIGH>  // COL 4 — R / G / B            (подтверждено логом: R сидел на D15)
            , <&pro_micro 14 GPIO_ACTIVE_HIGH>  // COL 5 — T / H / N            (подтверждено логом: T сидел на D14)
            , <&pro_micro 16 GPIO_ACTIVE_HIGH>  // COL 6 — внешняя колонка, GUI (гипотеза: D16 - единственный
                                                //          оставшийся пин из набора правой половины;
                                                //          в верхнем ряду он не отозвался ни на что)
            ;

        row-gpios
            = <&pro_micro 4 (GPIO_ACTIVE_HIGH | GPIO_PULL_DOWN)>  // ROW 0 — верхний ряд     (подтверждено логом)
            , <&pro_micro 5 (GPIO_ACTIVE_HIGH | GPIO_PULL_DOWN)>  // ROW 1 — домашний ряд    (подтверждено логом)
            , <&pro_micro 6 (GPIO_ACTIVE_HIGH | GPIO_PULL_DOWN)>  // ROW 2 — нижний ряд      (подтверждено логом)
            , <&pro_micro 7 (GPIO_ACTIVE_HIGH | GPIO_PULL_DOWN)>  // ROW 3 — большие пальцы  (подтверждено логом)
            ;
    };
};

&default_transform {
    col-offset = <0>;
};
